## src/kern/arm/bsp/gen/Kconfig
```kconfig
# PF: ARM_GEN
# PFDESCR: Generic Platform
# PFSELECT: CAN_ARM_CPU_CORTEX_A15 CAN_ARM_CPU_CORTEX_A57
# PFSELECT: ARM_GIC
# PFSELECT: ARM_PSCI HAS_ARM_PSCI HAS_ARM_PSCI_DYNAMIC
# PFSELECT: HAS_ARM_SVE
# PFSELECT: ARM_IOMMU_COHERENT
# PFSELECT: HAS_DT_OPTION
# PFDEPENDS: ARM

config PF_ARM_GEN_SELECT_SUPPORT
	bool "Generic platform: Select specific support"
	help
	  Configure specific hardware support for the generic platform.
	  On default, all support is available.
	
	  Select n if unsure.

config PF_ARM_GEN_SELECT_ACPI
	bool "Support ACPI" if PF_ARM_GEN_SELECT_SUPPORT
	default y
	select ARM_ACPI
	select PF_ARM_GEN_SELECT_GICV3

config ARM_IOMMU_MAX
	int "Maximum number of IOMMUs support" if PF_ARM_GEN_SELECT_SUPPORT
	depends on IOMMU
	default 16

config PF_ARM_GEN_SELECT_GICV2
	bool "Support GICv2" if PF_ARM_GEN_SELECT_SUPPORT
	default y
	select HAVE_ARM_GICV2

config PF_ARM_GEN_SELECT_GICV3
	bool "Support GICv3/4" if PF_ARM_GEN_SELECT_SUPPORT
	default y
	select HAVE_ARM_GICV3
	select HAVE_ARM_GIC_MSI
	select ARM_GIC_MSI

config PF_ARM_GEN_SELECT_SMMU_V3
	bool "Support SMMUv3" if PF_ARM_GEN_SELECT_SUPPORT
	default y
	select HAS_IOMMU_ARM_SMMU_V3

config PF_ARM_GEN_SELECT_UART_PL011
	bool "Support UART pl011" if PF_ARM_GEN_SELECT_SUPPORT
	default y

config PF_ARM_GEN_SELECT_UART_16550
	bool "Support UART 16550" if PF_ARM_GEN_SELECT_SUPPORT
	default y

config PF_ARM_GEN_SELECT_UART_CADENCE
	bool "Support UART cadence" if PF_ARM_GEN_SELECT_SUPPORT
	default y

config PF_ARM_GEN_SELECT_UART_LINFLEX
	bool "Support UART linflex" if PF_ARM_GEN_SELECT_SUPPORT
	default y

config PF_ARM_GEN_SELECT_UART_SH
	bool "Support UART sh" if PF_ARM_GEN_SELECT_SUPPORT
	default y

config PF_ARM_GEN_SELECT_UART_DCC
	bool "Support UART DCC" if PF_ARM_GEN_SELECT_SUPPORT
	default y

config PF_ARM_GEN_SELECT_UART_IMX
	bool "Support UART i.MX" if PF_ARM_GEN_SELECT_SUPPORT
	default y

config PF_ARM_GEN_SELECT_UART_LPUART
	bool "Support UART lpuart" if PF_ARM_GEN_SELECT_SUPPORT
	default y

config PF_ARM_GEN_SELECT_DT
	bool
	default y if !ARM_ACPI
	select DT
```

## src/kern/arm/bsp/imx/Kconfig
```kconfig
# PF: IMX
# PFDESCR: NXP/Freescale i.MX
# PFDEPENDS: ARM

choice
	prompt "NXP/Freescale i.MX"
	default PF_IMX_51

config PF_IMX_21
	bool "i.MX21"
	depends on PF_IMX
	select CAN_ARM_CPU_926
	help
	  Choose for i.MX21.

config PF_IMX_28
	bool "i.MX28"
	depends on PF_IMX
	select CAN_ARM_CPU_926
	help
	  Choose for i.MX28.

config PF_IMX_35
	bool "i.MX35"
	depends on PF_IMX
	select CAN_ARM_CPU_1136
        help
          Choose for i.MX35 platform.

config PF_IMX_51
	bool "i.MX51"
	depends on PF_IMX
	select CAN_ARM_CPU_CORTEX_A8
	help
	  Choose for i.MX51.

# remove comment when actually tested...
#config PF_IMX_53
#	bool "i.MX53"
#	depends on PF_IMX
#	select CAN_ARM_CPU_CORTEX_A8
#	help
#	  Choose for i.MX53.

config PF_IMX_6
        bool "i.MX6"
        depends on PF_IMX
        select CAN_ARM_CPU_CORTEX_A9
	select CAN_ARM_CACHE_L2CXX0
        help
          Choose for i.MX6 platform.

config PF_IMX_6UL
        bool "i.MX6UL"
        depends on PF_IMX
        select CAN_ARM_CPU_CORTEX_A7
        select HAS_CPU_VIRT
        help
          Choose for i.MX6UL platform.

endchoice

config PF_IMX_RAM_PHYS_BASE
	hex
	default 0xc0000000 if PF_IMX_21
	default 0x40000000 if PF_IMX_28
	default 0x80000000 if PF_IMX_35 || PF_IMX_6UL
	default 0x90000000 if PF_IMX_51
        default 0x10000000 if PF_IMX_6

choice
	prompt "Choose timer for i.MX6"
	depends on ARM_CORTEX_A9
	default PF_IMX_6_TIMER_MPTIMER

config PF_IMX_6_TIMER_MPTIMER
        bool "Use CPU-local MP-timer"

config PF_IMX_6_TIMER_EPIT
        bool "Use EPIT timer"

endchoice
```

## src/kern/arm/bsp/layerscape/Kconfig
```kconfig
# PF: LAYERSCAPE
# PFDESCR: NXP/Freescale Layerscape
# PFSELECT: HAS_ARM_PSCI ARM_GIC HAVE_ARM_GICV2
# PFDEPENDS: ARM

choice
	prompt "Layerscape variant"
	default PF_LS1021A

config PF_LS1021A
	bool "LS1021A"
	select CAN_ARM_CPU_CORTEX_A7
	select HAS_IOMMU_OPTION

config PF_LS1012A
	bool "LS1012A"
	select CAN_ARM_CPU_CORTEX_A53

endchoice

config ARM_IOMMU_NUM
  int
  default 4 if IOMMU

config IOMMU_ARM_SMMU_400
  bool
  select ARM_IOMMU_COHERENT
  default y if IOMMU
```

## src/kern/arm/bsp/lx2160/Kconfig
```kconfig
# PF: LX2160
# PFDESCR: NXP LX2160
# PFSELECT: CAN_ARM_CPU_CORTEX_A72 HAS_ARM_PSCI
# PFSELECT: ARM_PSCI ARM_GIC HAVE_ARM_GICV3 HAVE_ARM_GIC_MSI
# PFSELECT: ARM_IOMMU_COHERENT HAS_IOMMU_ARM_SMMU_500
# PFDEPENDS: ARM

config ARM_IOMMU_NUM
	int
	default 1 if IOMMU
```

## src/kern/arm/bsp/omap/Kconfig
```kconfig
# PF: OMAP
# PFDESCR: TI OMAP
# PFDEPENDS: ARM

choice
	prompt "OMAP Platform"
	depends on PF_OMAP
	default PF_OMAP4_PANDABOARD

config PF_OMAP3_OMAP35XEVM
	bool "TI OMAP35xEVM"
	select CAN_ARM_CPU_CORTEX_A8
	help
	  Choose for OMAP35xEVM platform.

config PF_OMAP3_BEAGLEBOARD
	bool "Beagle Board"
	select CAN_ARM_CPU_CORTEX_A8
	help
	  Choose for Beagleboard.

config PF_OMAP3_AM33XX
	bool "TI AM33xx"
	select CAN_ARM_CPU_CORTEX_A8
	help
	  Choose for AM33xx platforms (e.g. Beaglebone).

config PF_OMAP4_PANDABOARD
	bool "Pandaboard"
	depends on PF_OMAP
	select CAN_ARM_CPU_CORTEX_A9
	select CAN_ARM_CACHE_L2CXX0
	help
	  Choose for Pandaboard.

config PF_OMAP5_5432EVM
        bool "OMAP5432EVM"
	select CAN_ARM_CPU_CORTEX_A15
	select HAS_CPU_VIRT
	select DEFAULT_ARM_EM_NS if CPU_VIRT
        help
          Choose for OMAP5432EVM.

endchoice
```

## src/kern/arm/bsp/qcom/Kconfig
```kconfig
# PF: QCOM
# PFDESCR: Qualcomm Snapdragon
# PFDEPENDS: ARM
# PFSELECT: DEFAULT_ARM_EM_NS
# PFSELECT: ARM_GIC

choice
  prompt "Qualcomm Platform"
  depends on PF_QCOM
  default PF_QCOM_MSM8916

config PF_QCOM_MSM8226
  bool "MSM8226"
  select CAN_ARM_CPU_CORTEX_A7
  select HAVE_ARM_GICV2
  select PF_QCOM_UART_DM
  help
    Choose for Qualcomm Snapdragon 400 (MSM8226) platform.

config PF_QCOM_MSM8909
  bool "MSM8909"
  select CAN_ARM_CPU_CORTEX_A7
  select HAVE_ARM_GICV2
  select HAS_ARM_PSCI
  select HAS_IOMMU_OPTION
  select ARM_IOMMU_COHERENT
  select PF_QCOM_UART_DM
  help
    Choose for Qualcomm Snapdragon 210 (MSM8909) platform.

config PF_QCOM_MSM8916
  bool "MSM8916"
  select CAN_ARM_CPU_CORTEX_A53
  select HAVE_ARM_GICV2
  select HAS_ARM_PSCI
  select HAS_IOMMU_OPTION
  select ARM_IOMMU_COHERENT
  select PF_QCOM_UART_DM
  help
    Choose for Qualcomm Snapdragon 410 (MSM8916) platform.

config PF_QCOM_MSM8939
  bool "MSM8939"
  select CAN_ARM_CPU_CORTEX_A53
  select HAVE_ARM_GICV2
  select HAS_ARM_PSCI
  select HAS_IOMMU_OPTION
  select ARM_IOMMU_COHERENT
  select PF_QCOM_UART_DM
  help
    Choose for Qualcomm Snapdragon 615 (MSM8939) platform.

config PF_QCOM_MSM8974
  bool "MSM8974"
  select CAN_ARM_CPU_KRAIT
  select HAVE_ARM_GICV2
  select PF_QCOM_UART_DM
  help
    Choose for Qualcomm Snapdragon 800 (MSM8974) platform.

config PF_QCOM_SM8150
  bool "SM8150"
  select CAN_ARM_CPU_CORTEX_A76
  select HAVE_ARM_GICV3
  select HAVE_ARM_GIC_MSI
  select ARM_GIC_NOT_COHERENT
  select HAS_ARM_PSCI
  select ARM_PSCI
  select HAS_IOMMU_OPTION
  select ARM_IOMMU_COHERENT
  select PF_QCOM_UART_GENI
  help
    Choose for Qualcomm Snapdragon 855 (SM8150) platform.

endchoice

config PF_QCOM_UART_DM
  bool

config PF_QCOM_UART_GENI
  bool

config ARM_IOMMU_NUM
  int
  default 1 if IOMMU && PF_QCOM_SM8150
  default 2 if IOMMU && !PF_QCOM_SM8150

config IOMMU_ARM_SMMU_500
  bool
  default y if IOMMU

config PF_QCOM_RAM_PHYS_BASE
  hex
  default 0x00000000 if PF_QCOM_MSM8226 || PF_QCOM_MSM8974
  default 0x80000000 if PF_QCOM_MSM8909 || PF_QCOM_MSM8916 || \
                        PF_QCOM_MSM8939 || PF_QCOM_SM8150
```

## src/kern/arm/bsp/realview/Kconfig
```kconfig
# PF: REALVIEW
# PFDESCR: ARM RealView Platform
# PFDEPENDS: ARM

choice
	prompt "Realview Platform"
	default PF_REALVIEW_EB

config PF_REALVIEW_EB
	bool "Emulation Baseboard (EB)"
	depends on PF_REALVIEW
	select CAN_ARM_CPU_926
	select CAN_ARM_CPU_1176
	select CAN_ARM_CPU_MPCORE
	select CAN_ARM_CPU_CORTEX_A8
	select CAN_ARM_CPU_CORTEX_A9
	select CAN_ARM_CACHE_L2CXX0 if ARM_MPCORE
	help
	  Choose for Emulation Baseboard (EB)

config PF_REALVIEW_PB11MP
	bool "PB11MP"
	depends on PF_REALVIEW
	select CAN_ARM_CPU_MPCORE
	select CAN_ARM_CACHE_L2CXX0
	help
	  Choose for PB11MP

config PF_REALVIEW_PBX
	bool "PBX"
	depends on PF_REALVIEW
	select CAN_ARM_CPU_CORTEX_A9
	select CAN_ARM_CACHE_L2CXX0
	help
	  Choose for PBX-A9.

config PF_REALVIEW_VEXPRESS
	bool "Versatile Express"
	depends on PF_REALVIEW
	select CAN_ARM_CPU_CORTEX_A9
	select CAN_ARM_CPU_CORTEX_A15
	help
	  Choose for Versatile Express.

endchoice

config PF_REALVIEW_VEXPRESS_A9
	def_bool y
	depends on PF_REALVIEW_VEXPRESS && ARM_CORTEX_A9

config PF_REALVIEW_VEXPRESS_A15
	def_bool y
	depends on PF_REALVIEW_VEXPRESS && ARM_CORTEX_A15

choice
	prompt "Start of RAM (physical address)" if !PF_REALVIEW_EB
	default PF_REALVIEW_RAM_PHYS_BASE_0x6 if PF_REALVIEW_VEXPRESS_A9
	default PF_REALVIEW_RAM_PHYS_BASE_0x0

config PF_REALVIEW_RAM_PHYS_BASE_0x0
	bool "0x00000000"
	depends on !ARM_CORTEX_A15

config PF_REALVIEW_RAM_PHYS_BASE_0x2
	bool "0x20000000"
	depends on PF_REALVIEW_PBX

config PF_REALVIEW_RAM_PHYS_BASE_0x6
	bool "0x60000000"
	depends on PF_REALVIEW_VEXPRESS_A9

config PF_REALVIEW_RAM_PHYS_BASE_0x7
	bool "0x70000000"
	depends on PF_REALVIEW_PBX || PF_REALVIEW_PB11MP

config PF_REALVIEW_RAM_PHYS_BASE_0x8
	bool "0x80000000"
	depends on PF_REALVIEW_VEXPRESS_A15

endchoice

config PF_REALVIEW_RAM_PHYS_BASE
	hex
	default 0x0        if !PF_REALVIEW_RAM_PHYS_BASE_0x2 && !PF_REALVIEW_RAM_PHYS_BASE_0x6 && !PF_REALVIEW_RAM_PHYS_BASE_0x7 && !PF_REALVIEW_RAM_PHYS_BASE_0x8
	default 0x20000000 if PF_REALVIEW_RAM_PHYS_BASE_0x2
	default 0x60000000 if PF_REALVIEW_RAM_PHYS_BASE_0x6
	default 0x70000000 if PF_REALVIEW_RAM_PHYS_BASE_0x7
	default 0x80000000 if PF_REALVIEW_RAM_PHYS_BASE_0x8
```
