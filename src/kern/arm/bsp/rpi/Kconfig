## src/kern/arm/bsp/rpi/Kconfig
```kconfig
# PF: RPI
# PFDESCR: Raspberry Pi (Broadcom 283X & 2711)
# PFDEPENDS: ARM

config PF_RPI_UART_16550
        bool

config PF_RPI_UART_PL011
        bool

choice
        prompt "Raspberry Pi variant"
        default PF_RPI_RPI3

config PF_RPI_RPI1
        bool "rpi1"
        depends on PF_RPI
        select RPI
        select PF_RPI_UART_PL011
        select CAN_ARM_CPU_1176

config PF_RPI_RPI2
        bool "rpi2"
        depends on PF_RPI
        select RPI
        select PF_RPI_UART_PL011
        select CAN_ARM_CPU_CORTEX_A7

config PF_RPI_RPI3
        bool "rpi3"
        depends on PF_RPI
        select RPI
        select PF_RPI_UART_16550
        select CAN_ARM_CPU_CORTEX_A53

config PF_RPI_RPIZW
        bool "rpizw"
        depends on PF_RPI
        select RPI
        select PF_RPI_UART_16550
        select CAN_ARM_CPU_1176

config PF_RPI_RPI4
        bool "rpi4"
        depends on PF_RPI
        select PF_RPI_UART_16550
        select CAN_ARM_CPU_CORTEX_A72
        select ARM_GIC
        select HAVE_ARM_GICV2

endchoice
```

## src/kern/arm/bsp/s32g/Kconfig
```kconfig
# PF: S32G
# PFDESCR: NXP S32G
# PFSELECT: CAN_ARM_CPU_CORTEX_A53 ARM_GIC HAVE_ARM_GICV3 HAS_ARM_PSCI
# PFDEPENDS: ARM


choice
	prompt "S32G Variant"
	default PF_S32G2
	depends on PF_S32G

config PF_S32G2
	bool "S32G2"

config PF_S32G3
	bool "S32G3"
	select ARM_PSCI

endchoice
```

## src/kern/arm/bsp/s32k5/Kconfig
```kconfig
# Copyright 2025 NXP
# SPDX-License-Identifier: MIT

# PF: S32K5
# PFDESCR: NXP S32K5
# PFSELECT: CAN_ARM_CPU_CORTEX_R52 ARM_GIC HAVE_ARM_GICV3 HAS_PLAT_AMP_OPTION
# PFDEPENDS: ARM

config PF_S32K5_RAM_BASE
	hex "Kernel load address"
	default 0x22000000
	help
	  Start address of the kernel image. Defaults to start of CPE SRAM0.
```

## src/kern/arm/bsp/s32n/Kconfig
```kconfig
# Copyright 2023-2025 NXP
# SPDX-License-Identifier: MIT

# PF: S32N
# PFDESCR: NXP S32N
# PFSELECT: CAN_ARM_CPU_CORTEX_R52 ARM_GIC HAVE_ARM_GICV3 HAS_PLAT_AMP_OPTION
# PFDEPENDS: ARM

choice
	prompt "NXP S32N"
	default PF_S32N5

config PF_S32N5
	bool "NXP S32N5"
	depends on PF_S32N
	help
	  Choose for NXP S32N5 series.

endchoice # PF_S32N

choice
	prompt "RTU config"
	default PF_S32N_RTU_0

config PF_S32N_RTU_0
	bool "RTU0"
	depends on PF_S32N5

config PF_S32N_RTU_1
	bool "RTU1"
	depends on PF_S32N5

config PF_S32N_RTU_2
	bool "RTU2"
	depends on PF_S32N5

config PF_S32N_RTU_3
	bool "RTU3"
	depends on PF_S32N5

endchoice # RTU

choice
	prompt "RTU Cluster 0 configuration"
	default PF_S32N_RTU_CL0_LOCKSTEP

config PF_S32N_RTU_CL0_DISABLED
	bool "disabled"

config PF_S32N_RTU_CL0_LOCKSTEP
	bool "lockstep"

config PF_S32N_RTU_CL0_SPLIT
	bool "split mode"

endchoice # RTU Cluster 0

choice
	prompt "RTU Cluster 1 configuration"
	default PF_S32N_RTU_CL1_LOCKSTEP

config PF_S32N_RTU_CL1_DISABLED
	bool "disabled"

config PF_S32N_RTU_CL1_LOCKSTEP
	bool "lockstep"

config PF_S32N_RTU_CL1_SPLIT
	bool "split mode"

endchoice # RTU Cluster 1

config PF_S32N_AUTO_RAM_BASE
	bool "Automatically choose RAM_BASE"
	default y
	help
	  Use default RAM base address. Uses CRAM0 of the respective cluster:

	  RTU0: 0x39580000
	  RTU1: 0x3b580000
	  RTU2: 0x3d580000
	  RTU3: 0x3f580000

config PF_S32N_MANUAL_RAM_BASE
	hex "Custom RAM_BASE"
	depends on !PF_S32N_AUTO_RAM_BASE
	default 0x39580000 if PF_S32N_RTU_0
	default 0x3b580000 if PF_S32N_RTU_1
	default 0x3d580000 if PF_S32N_RTU_2
	default 0x3f580000 if PF_S32N_RTU_3

config PF_S32N_MRU
	bool "MRU interrupt support"
	default y
	help
	  This driver enables support for receiving interrupts from MRU instances
	  that are connected as PPI to each core. Each MRU channel is available as
	  dedicated interrupt, starting from 1024.
```

## src/kern/arm/bsp/s32z/Kconfig
```kconfig
# PF: S32Z
# PFDESCR: NXP S32Z2/S32E2
# PFSELECT: CAN_ARM_CPU_CORTEX_R52 ARM_GIC HAVE_ARM_GICV3
# PFDEPENDS: ARM

choice
	prompt "RTU config"
	default PF_S32Z_RTU_ALL

config PF_S32Z_RTU_ALL
	bool "RTU0+RTU1"

config PF_S32Z_RTU_0
	bool "RTU0"

config PF_S32Z_RTU_1
	bool "RTU1"

endchoice

config PF_S32Z_AUTO_RAM_BASE
	bool "Automatically choose RAM_BASE"
	default y
	help
	  Use default RAM base address. Uses CRAM0 of the respective cluster:

	  RTU0: 0x32100000
	  RTU1: 0x36100000

config PF_S32Z_MANUAL_RAM_BASE
	hex "Custom RAM_BASE"
	depends on !PF_S32Z_AUTO_RAM_BASE
	default 0x32100000

choice
	prompt "AMP boot method"
	default PF_S32Z_AMP_SPIN_ADDR
	depends on AMP
	help
	  Method how the kernel is booted on multiple CPUs.

config PF_S32Z_AMP_SPIN_ADDR
	bool "Spin address"
	help
	  CPUs are started by another firmware.

config PF_S32Z_AMP_RELEASE
	bool "Release reset"
	help
	  Except the boot CPU all other cores are in reset. The other cores
	  are started by programming MC_ME and MC_RGM directly.

endchoice

config PF_S32Z_MRU
	bool "MRU interrupt support"
	default y
	help
	  The MRU is connected as PPI to each core. This driver enables support
	  for receiving interrupts from MRU channels. Each MRU channel is
	  available as dedicated interrupt, starting from 1024.
```

## src/kern/arm/bsp/sbsa/Kconfig
```kconfig
# PF: SBSA
# PFDESCR: SystemReady SR (SBSA Level 4)
# PFSELECT: BIT64_CHOICE
# PFSELECT: CAN_ARM_CPU_CORTEX_A76 CAN_ARM_CPU_NEOVERSE_N1
# PFSELECT: ARM_GIC HAVE_ARM_GICV3 HAVE_ARM_GIC_MSI
# PFSELECT: HAS_ARM_PSCI HAS_ARM_PSCI_DYNAMIC ARM_PSCI ARM_ACPI
# PFSELECT: ARM_ASID16
# PFSELECT: HAS_ARM_SVE
# PFSELECT: ARM_IOMMU_COHERENT HAS_IOMMU_ARM_SMMU_V3
# PFDEPENDS: ARM

config ARM_IOMMU_MAX
  int "Maximum number of SMMUs"
  depends on IOMMU
  default 16
  help
    The size of some IOMMU related data structures depend on the number of
    supported IOMMUs. Setting the value too high increases the memory
    allocation overhead. A too low value will prevent the kernel from booting,
    though.

    If in doubt, leave the default (16).

# According to the spec, the SMMU should support stage1 _and_ stage2 tables.
# But on Graviton3 this does not seem to be the case. So use stage2 if we run
# as hypervisor to be on the safe side.
config ARM_IOMMU_STAGE2
	bool
	default y if IOMMU && CPU_VIRT
```

## src/kern/arm/bsp/tegra/Kconfig
```kconfig
# PF: TEGRA
# PFDESCR: NVIDIA Jetson Orin / Tegra platform
# PFSELECT: ARM_GIC
# PFDEPENDS: ARM

choice
	prompt "Jetson Orin / Tegra Platform"
	default PF_TEGRA_ORIN

config PF_TEGRA_TEGRA2
	bool "Tegra2"
	depends on PF_TEGRA
	select CAN_ARM_CPU_CORTEX_A9
	select CAN_ARM_CACHE_L2CXX0
	select HAVE_ARM_GICV2

config PF_TEGRA_TEGRA3
	bool "Tegra3"
	depends on PF_TEGRA
	select CAN_ARM_CPU_CORTEX_A9
	select CAN_ARM_CACHE_L2CXX0
	select HAVE_ARM_GICV2

config PF_TEGRA_ORIN
	bool "Jetson Orin"
	depends on PF_TEGRA
	select CAN_ARM_CPU_CORTEX_A76
	select HAVE_ARM_GICV3
	select ARM_PSCI
	select HAS_ARM_PSCI
	select HAS_DT_OPTION
	select DT
endchoice

choice
	prompt "Platform Timer"
	default PF_TEGRA_TIMER_MP

config PF_TEGRA_TIMER_MP
	bool "MP timer"
	depends on PF_TEGRA_TEGRA2 || PF_TEGRA_TEGRA3
	help
	  ARM local-core multi-processor timer.

config PF_TEGRA_TIMER_TMR
	bool "TMR timer"
	depends on PF_TEGRA_TEGRA2 || PF_TEGRA_TEGRA3
	help
	  Single broadcasting timer.

config PF_TEGRA_TIMER_GENERIC
	bool "Generic Timer"
	depends on PF_TEGRA_ORIN

endchoice
```

## src/kern/arm/bsp/virt/Kconfig
```kconfig
# PF: ARM_VIRT
# PFDESCR: QEMU ARM Virtual Platform
# PFSELECT: CAN_ARM_CPU_CORTEX_A15 CAN_ARM_CPU_CORTEX_A57 HAS_ARM_PSCI
# PFSELECT: ARM_PSCI FORCE_ARM_PSCI_HVC
# PFSELECT: ARM_GIC HAVE_ARM_GICV2 HAVE_ARM_GICV3 HAVE_ARM_GIC_MSI
# PFSELECT: HAS_ARM_SVE
# PFSELECT: HAS_IOMMU_ARM_SMMU_V3 ARM_IOMMU_COHERENT
# PFDEPENDS: ARM

config ARM_IOMMU_NUM
	int
	default 1 if IOMMU
```

## src/kern/ia32/Kconfig
```kconfig
# ARCH:           IA32 ia32
# ARCHDESCR:      Intel IA-32 processor family
# ARCHSELECT:     BIT32
# ARCHSELECT:     HAS_VIRT_OBJ_SPACE_OPTION
# ARCHSELECT:     HAS_JDB_DISASM_OPTION
# ARCHSELECT:     HAS_JDB_GZIP_OPTION
# ARCHSELECT:     FPU
# ARCHSELECT:     HAS_FPU_OPTION
# ARCHSELECT:     HAS_LAZY_FPU
# ARCHSELECT:     HAS_SYNC_CLOCK if (!MP || TSC_UNIFIED)
# ARCHDEFAULTPF:  PF_PC
#
# ARCH:           AMD64 amd64
# ARCHDESCR:      AMD64 processor family
# ARCHSELECT:     HAS_VIRT_OBJ_SPACE_OPTION
# ARCHSELECT:     HAS_JDB_DISASM_OPTION
# ARCHSELECT:     HAS_JDB_GZIP_OPTION
# ARCHSELECT:     HAS_COV_OPTION
# ARCHSELECT:     BIT64
# ARCHSELECT:     FPU
# ARCHSELECT:     HAS_FPU_OPTION
# ARCHSELECT:     HAS_LAZY_FPU
# ARCHSELECT:     HAS_SYNC_CLOCK if (!MP || TSC_UNIFIED)
# ARCHDEFAULTPF:  PF_PC

# PF: PC
# PFDESCR: PC platform
# PFDEPENDS: IA32 || AMD64
# PFSELECT: HAS_SERIAL_OPTION
# PFSELECT: HAS_WATCHDOG_OPTION
# PFSELECT: HAS_IOMMU_OPTION
# PFSELECT: HAS_MP_OPTION
# PFSELECT: HAS_CPU_VIRT

# SECTION: TARGET

choice
	prompt "Timer tick source"
	default SCHED_APIC

config SCHED_PIT
	bool "Use PIT for scheduling"
	depends on !MP
	help
	  Normally, Fiasco uses the RTC at IRQ8 for scheduling. This can be
	  disadvantageous in certain circumstances, e.g. VMWare doesn't seem
	  to emulate the RTC good enough so that not enough timer interrupts
	  are produced. The PIT mode (using IRQ0) seems to work better in
	  this case.  It is generally safe to use this option, so if you are
	  unsure, say 'Y'.

	  Consider that the interrupt priorities change: Using RTC, IRQ8 has
	  the highest priority. Using PIT, IRQ0 has the highest priority.
	  The only case where PIT scheduling does not work is with
	  profiling. If profiling is enabled the PIT is used for generating
	  the profiling interrupts.

config SCHED_RTC
	bool "Use RTC for scheduling"
	depends on !MP
	help
	  'Yes' is the standard for this option. If this option is set
	  Fiasco uses the RTC on IRQ 8 for scheduling.  This can be
	  disadvantageous in certain circumstances, e.g. VMWare doesn't seem
	  to emulate the RTC good enough so that not enough timer interrupts
	  are produced.  The PIT (8254) mode (say 'no' here), seems to work
	  better in this case. It is generally safe to use the PIT, so if
	  you are unsure, say 'no'.
	  Consider that the interrupt priorities change: Using RTC, IRQ8 has
	  the highest priority. Using PIT, IRQ0 has the highest priority.
	  The only case where PIT scheduling does not work is with
	  profiling. If profiling is enabled the PIT is used for generating
	  the profiling interrupts and the RTC must be used for scheduling.
	  In the case where profiling shall be used within VMWare the
	  SLOW_RTC option must be set, so that the timer resolution of
	  Fiasco is reduced to 100Hz.

config SCHED_APIC
	bool "Use APIC timer for scheduling"
	help
	  Use the Local APIC for scheduling.

config SCHED_HPET
	bool "Use HPET timer for scheduling (EXPERIMENTAL)"
	depends on !MP && EXPERIMENTAL
	help
	  Use the HPET timer for scheduling.

endchoice

config SLOW_RTC
	bool "Use RTC with 100 ticks per second"
	depends on SCHED_RTC
	help
	  This option should be enabled if you use VMWare and no PIT
	  scheduling. The timer resolution is lowered to 100 ticks per
	  second.

config WORKAROUND_AMD_FPU_LEAK
	bool "Enables workaroud for AMD FPU security leak"
	help
	  If you use Fiasco for high assurance, high security and use AMD
	  CPUs you should enable this option. In any other case it is no
	  harm to disable it.

config REGPARM3
	def_bool y
	depends on IA32 && !AMD64 && PF_PC

config NO_LDT
	bool "Disable support for the LDT" if (IA32 || AMD64) && !KERNEL_ISOLATION
	default y
	help
	  This option disables support for the X86 local descriptor
	  table (LDT).  This reduces some overhead. However, this
	  also makes the use of the LDT in L4Linux impossible.

config TSC_UNIFIED
	bool "Depend on unified TSC across CPU cores"
	depends on MP
	help
	  Require unified TSCs across CPU cores. If this CPU feature is present,
	  the TSC is synchronized accross all CPU cores of the same chip and
	  does not stop in any ACPI state. In that case the time stamp counter
	  can be used as consistent clock source in an MP system.

	  Scheduling in one-shot mode depends on this option. If this option is
	  enabled but the CPU feature is not present, the kernel warns.

	  Unfortunately we cannot panic in that case because QEMU does not
	  support this CPU feature in TCG.
```

## src/kern/mips/Kconfig
```kconfig
# ARCH:           MIPS mips
# ARCHDESCR:      MIPS processor family
#
# ARCHSELECT:     HAS_FPU_OPTION
# ARCHSELECT:     HAS_SERIAL_OPTION
# ARCHSELECT:     HAS_CPU_VIRT
#
# ARCHDEFAULTPF:  PF_MALTA

# SECTION: CPU

choice
	prompt "CPU"
	default CPU_MIPS32_R2

config CPU_MIPS32_R2
	bool "MIPS32 Release 2"
	depends on SYS_HAS_CPU_MIPS32_R2 || SYS_HAS_CPU_MIPS64_R2
	select BIT32
	select CPU_MIPS32
	select CPU_MIPSR2
	help
	  Choose this if you have a MIPS32 Release 2 CPU.

config CPU_MIPS32_R6
	bool "MIPS32 Release 6"
	depends on SYS_HAS_CPU_MIPS32_R6 || SYS_HAS_CPU_MIPS64_R6
	select BIT32
	select CPU_MIPS32
	select CPU_MIPSR6
	select WEAK_ORDERING
	select LIGHTWEIGHT_BARRIERS
	help
	  Choose this if you have a MIPS32 Release 6 CPU and toolchain.

config CPU_MIPS64_R2
	bool "MIPS64 Release 2"
	depends on SYS_HAS_CPU_MIPS64_R2
	select BIT64
	select CPU_MIPS64
	select CPU_MIPSR2
	select CONTEXT_8K
	help
	  Choose this if you have a MIPS64 Release 2 CPU.

config CPU_MIPS64_R6
	bool "MIPS64 Release 6"
	depends on SYS_HAS_CPU_MIPS64_R6
	select BIT64
	select CPU_MIPS64
	select CPU_MIPSR6
	select CONTEXT_8K
	select WEAK_ORDERING
	select LIGHTWEIGHT_BARRIERS
	help
	  Choose this if you have a MIPS64 Release 6 CPU and toolchain.

endchoice

if MP
config WEAK_ORDERING
	bool
	prompt "Weakly ordered memory access" \
	  if HAS_WEAK_ORDERING_OPTION && !CPU_MIPSR6
	default y
	help
	  Choose this if you have a MIPS32 Release 2+ CPU with
	  weak memory ordering.
	  Say 'Y' if unsure.

config LIGHTWEIGHT_BARRIERS
	def_bool DEFAULT_LIGHTWEIGHT_BARRIERS
	prompt "Use lightweight barriers" \
	  if HAS_LIGHTWEIGHT_BARRIERS_OPTION && !CPU_MIPSR6 && WEAK_ORDERING
	help
	  Choose this option if your CPU supports lightweight sync instructions.
	  In particular sync 0x4, sync 0x10, sync 0x11, sync 0x12, sync 0x13 must
	  be supported.

endif

# SECTION: GLOBAL

config SYS_HAS_CPU_MIPS32_R2
	bool

config SYS_HAS_CPU_MIPS32_R6
	bool

config SYS_HAS_CPU_MIPS64_R2
	bool

config SYS_HAS_CPU_MIPS64_R6
	bool

config HAS_WEAK_ORDERING_OPTION
	bool

config HAS_LIGHTWEIGHT_BARRIERS_OPTION
	bool

config CPU_MIPS32
	bool

config CPU_MIPS64
	bool

config CPU_MIPSR2
	bool

config CPU_MIPSR6
	bool

config CAN_MIPS_VZ_ASE
	bool

# SECTION: TARGET

config MIPS_CPU_FREQUENCY
	int "CPU frequency (MHz)"
	depends on MIPS
	default 200
	help
	  Set the CPU frequency to match the platform's cpu frequency
	  for proper time keeping.

choice
        prompt "Minimum page size"
        default MIPS_PAGE_SIZE_16K

config MIPS_PAGE_SIZE_4K
        bool "4KB minimum page size"

config MIPS_PAGE_SIZE_16K
        bool "16KB minimum page size"

endchoice
```

## src/kern/mips/bsp/malta/Kconfig
```kconfig
# PF: MALTA
# PFDESCR: MIPS Malta platform
# PFDEPENDS: MIPS
# PFSELECT: SYS_HAS_CPU_MIPS64_R2
# PFSELECT: SYS_HAS_CPU_MIPS64_R6
# PFSELECT: HAS_WEAK_ORDERING_OPTION
# PFSELECT: HAS_LIGHTWEIGHT_BARRIERS_OPTION

choice
	prompt "Malta Platform"
	default PF_MALTA_UP

config PF_MALTA_UP
	bool "Single CPU Platform"
	depends on PF_MALTA
	select CAN_MIPS_VZ_ASE

config PF_MALTA_MP
	bool "Multicore CPU Platform"
	depends on PF_MALTA
	select HAS_MP_OPTION
	select CAN_MIPS_VZ_ASE
        help
          Use CONFIG_MP_MAX_CPUS to set the maximum supported number of CPUs

endchoice
```
