## src/kern/riscv/Kconfig
```kconfig
# ARCH:           RISCV riscv
# ARCHDESCR:      RISC-V processor family
#
# ARCHSELECT:     HAS_SERIAL_OPTION
# ARCHSELECT:     HAS_JDB_DISASM_OPTION
# ARCHSELECT:     HAS_LAZY_FPU
# ARCHSELECT:     HAS_SYNC_CLOCK
# ARCHSELECT:     HAS_ONE_SHOT if SYNC_CLOCK
# ARCHSELECT:     HAS_TICKLESS_IDLE
#
# ARCHDEFAULTPF:  PF_RISCV_VIRT

# SECTION: CPU

config CAN_RISCV_CPU_32IMA
	bool

config CAN_RISCV_CPU_64IMA
	bool

choice
	prompt "CPU"
	default RISCV_CPU_64IMA

config RISCV_CPU_32IMA
	bool "RV32IMA"
	depends on CAN_RISCV_CPU_32IMA
	select BIT32

config RISCV_CPU_64IMA
	bool "RV64IMA"
	depends on CAN_RISCV_CPU_64IMA
	select BIT64

endchoice

config CAN_RISCV_SV39
	bool

config CAN_RISCV_SV48
	bool

choice
	prompt "Virtual address space size"
	depends on BIT64
	default RISCV_SV48

config RISCV_SV39
	bool "Sv39"
	depends on CAN_RISCV_SV39

config RISCV_SV48
	bool "Sv48"
	depends on CAN_RISCV_SV48

endchoice

choice
	prompt "Precision"
	depends on FPU
	default RISCV_FPU_DOUBLE

config RISCV_FPU_SINGLE
	bool "Single precision"

config RISCV_FPU_DOUBLE
	bool "Double precision"

endchoice

config RISCV_ISA_C
	bool "Emit compressed instructions"
	default y

config RISCV_ASID
	bool

config CAN_RISCV_VMID
  bool

config RISCV_VMID
  depends on CPU_VIRT && CAN_RISCV_VMID
  bool
  default y

# SECTION: TARGET

config RISCV_SBI_V1
	bool
```

## src/kern/sparc/Kconfig
```kconfig
# ARCH:        SPARC sparc
# ARCHDESCR:   SPARC v8 processor family (Caution: EXPERIMENTAL)
#
# ARCHDEPENDS: EXPERIMENTAL && INCLUDE_SPARC
# ARCHSELECT:  BIT32
# ARCHSELECT:  CONTEXT_4K
# ARCHSELECT:  HAS_SERIAL_OPTION
#
# ARCHHELP:    SPARC v8 is supposed to run on the LEON3 platform.
# ARCHHELP:    It is unsupported at the moment.
#
# ARCHDEFAULTPF: PF_LEON3

# SECTION: CPU

choice
	prompt "CPU"
	default LEON3      if SPARC

config LEON3
	bool "Gaisler SPARC LEON3"
	depends on SPARC
	help
	  Choose this if you have a LEON3 CPU.

endchoice
```
